/* Contains Device Tree Mappings for Legacy AMI Drivers */
/  {	
	ami_drivers {

		compatible = "non_dt_devices";
			#address-cells = <0x1>;
			#size-cells = <0x1>;
			ranges;

#if defined(CONFIG_SPX_FEATURE_VIDEO_INT)
			ami_videocap {
				interrupts = <GIC_SPI 7 IRQ_TYPE_LEVEL_HIGH>;
				clocks = <&syscon ASPEED_CLK_GATE_VCLK>,
					 <&syscon ASPEED_CLK_GATE_ECLK>;
				clock-names = "vclk", "eclk";
				//resets = <&syscon ASPEED_RESET_VIDEO>;
				resets = <&syscon 0x00000006>;
			};
#else			
			ami_videocap {
                            reg = <0x1e7c8000 0x800 0x1e6ec000 0x800 0x1e7c0000 0x2000>;
                            clocks = <&syscon ASPEED_CLK_GATE_RVASCLK>;
                            clock-names = "rvasclk-gate";
                            interrupts = <GIC_SPI 98 IRQ_TYPE_LEVEL_HIGH>,
                            <GIC_SPI 163 IRQ_TYPE_LEVEL_HIGH>;
                            resets = <&syscon ASPEED_RESET_RVAS>;
                        };
#endif

		};
};
